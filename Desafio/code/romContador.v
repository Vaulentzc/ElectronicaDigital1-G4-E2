/*
 * Generated by Digital. Don't modify this file!
 * Any changes will be lost if this file is regenerated.
 */

module DIG_Counter_Nbit
#(
    parameter Bits = 2
)
(
    output [(Bits-1):0] out,
    output ovf,
    input C,
    input en,
    input clr
);
    reg [(Bits-1):0] count;

    always @ (posedge C) begin
        if (clr)
          count <= 'h0;
        else if (en)
          count <= count + 1'b1;
    end

    assign out = count;
    assign ovf = en? &count : 1'b0;

    initial begin
        count = 'h0;
    end
endmodule

module DIG_ROM_128X16_rom (
    input [6:0] A,   // Ahora 7 bits para direccionar 128 posiciones
    input sel,
    output reg [15:0] D
);
    reg [15:0] my_rom [0:127];

    always @ (*) begin
        if (~sel)
            D = 16'h1;  // Salida en alta impedancia si sel es 0
        else
            D = my_rom[A];
    end

    initial begin
        my_rom[0]   = 16'h14A; my_rom[1]   = 16'h14A; my_rom[2]   = 16'h14A; my_rom[3]   = 16'h0;
        my_rom[4]   = 16'h14A; my_rom[5]   = 16'h14A; my_rom[6]   = 16'h14A; my_rom[7]   = 16'h0;
        my_rom[8]   = 16'h15D; my_rom[9]   = 16'h15D; my_rom[10]  = 16'h15D; my_rom[11]  = 16'h0;
        my_rom[12]  = 16'h18F; my_rom[13]  = 16'h18F; my_rom[14]  = 16'h18F; my_rom[15]  = 16'h0;
        my_rom[16]  = 16'h18F; my_rom[17]  = 16'h18F; my_rom[18]  = 16'h18F; my_rom[19]  = 16'h0;
        my_rom[20]  = 16'h15D; my_rom[21]  = 16'h15D; my_rom[22]  = 16'h15D; my_rom[23]  = 16'h0;
        my_rom[24]  = 16'h14A; my_rom[25]  = 16'h14A; my_rom[26]  = 16'h14A; my_rom[27]  = 16'h0;
        my_rom[28]  = 16'h126; my_rom[29]  = 16'h126; my_rom[30]  = 16'h126; my_rom[31]  = 16'h0;
        my_rom[32]  = 16'h106; my_rom[33]  = 16'h106; my_rom[34]  = 16'h106; my_rom[35]  = 16'h0;
        my_rom[36]  = 16'h106; my_rom[37]  = 16'h106; my_rom[38]  = 16'h106; my_rom[39]  = 16'h0;
        my_rom[40]  = 16'h126; my_rom[41]  = 16'h126; my_rom[42]  = 16'h126; my_rom[43]  = 16'h0;
        my_rom[44]  = 16'h14A; my_rom[45]  = 16'h14A; my_rom[46]  = 16'h14A; my_rom[47]  = 16'h0;
        my_rom[48]  = 16'h14A; my_rom[49]  = 16'h14A; my_rom[50]  = 16'h14A; my_rom[51]  = 16'h0;
        my_rom[52]  = 16'h126; my_rom[53]  = 16'h126; my_rom[54]  = 16'h126; my_rom[55]  = 16'h0;
        my_rom[56]  = 16'h126; my_rom[57]  = 16'h126; my_rom[58]  = 16'h126; my_rom[59]  = 16'h0;
        my_rom[60]  = 16'h0; my_rom[61]  = 16'h0; my_rom[62]  = 16'h0; my_rom[63]  = 16'h0;
        my_rom[64]  = 16'h14A; my_rom[65]  = 16'h14A; my_rom[66]  = 16'h14A; my_rom[67]  = 16'h0;
        my_rom[68]  = 16'h14A; my_rom[69]  = 16'h14A; my_rom[70]  = 16'h14A; my_rom[71]  = 16'h0;
        my_rom[72]  = 16'h15D; my_rom[73]  = 16'h15D; my_rom[74]  = 16'h15D; my_rom[75]  = 16'h0;
        my_rom[76]  = 16'h18F; my_rom[77]  = 16'h18F; my_rom[78]  = 16'h18F; my_rom[79]  = 16'h0;
        my_rom[80]  = 16'h18F; my_rom[81]  = 16'h18F; my_rom[82]  = 16'h18F; my_rom[83]  = 16'h0;
        my_rom[84]  = 16'h15D; my_rom[85]  = 16'h15D; my_rom[86]  = 16'h15D; my_rom[87]  = 16'h0;
        my_rom[88]  = 16'h14A; my_rom[89]  = 16'h14A; my_rom[90]  = 16'h14A; my_rom[91]  = 16'h0;
        my_rom[92]  = 16'h126; my_rom[93]  = 16'h126; my_rom[94]  = 16'h126; my_rom[95]  = 16'h0;
        my_rom[96]  = 16'h106; my_rom[97]  = 16'h106; my_rom[98]  = 16'h106; my_rom[99]  = 16'h0;
        my_rom[100] = 16'h106; my_rom[101] = 16'h106; my_rom[102]  = 16'h106; my_rom[103]  = 16'h0;
        my_rom[104] = 16'h126; my_rom[105] = 16'h126; my_rom[106] = 16'h126; my_rom[107] = 16'h0;
        my_rom[108] = 16'h14A; my_rom[109] = 16'h14A; my_rom[110] = 16'h14A; my_rom[111] = 16'h0;
        my_rom[112] = 16'h126; my_rom[113] = 16'h126; my_rom[114] = 16'h126; my_rom[115] = 16'h0;
        my_rom[116] = 16'h106; my_rom[117] = 16'h106; my_rom[118] = 16'h106; my_rom[119] = 16'h0;
        my_rom[120] = 16'h106; my_rom[121] = 16'h106; my_rom[122] = 16'h106; my_rom[123] = 16'h106;
        my_rom[124] = 16'h106; my_rom[125] = 16'h106; my_rom[126] = 16'h0; my_rom[127] = 16'h0;
    end
endmodule

module romContador (
    input clk,
    input boton,
    output [15:0] data    
);
    wire [6:0] s0;
    wire s1;
    assign s1 = ~boton;

    DIG_Counter_Nbit #(
        .Bits(7)  // Ahora 7 bits para contar hasta 128
    ) DIG_Counter_Nbit_i0 (
        .en(1'b1),
        .C(clk),
        .clr(s1),
        .out(s0)
    );

    DIG_ROM_128X16_rom DIG_ROM_128X16_rom_i1 (
        .A(s0),
        .sel(boton),
        .D(data)
    );
endmodule

